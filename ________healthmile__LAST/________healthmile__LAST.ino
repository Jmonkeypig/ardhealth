#include <SoftwareSerial.h>
#include <Arduino.h>
#include <U8g2lib.h>
#include <SPI.h>
#include <Wire.h>

/*time function*/


/*system_status_value*/
#define SYSTEM_STATUS_READY 0
#define SYSTEM_STATUS_COUNT 1
#define SYSTEM_STATUS_PLAYING 2
#define SYSTEM_STATUS_PLAYING2 3
#define SYSTEM_STATUS_PLAYING3 4
#define SYSTEM_STATUS_END 5
#define SYSTEM_STATUS_ERROR 6
#define PLAY_TIMEOUT 29000


/*time_related function*/
//int sec = 0;
//int min = 0;
//int hour =0;
//int counter =0;

/*system_status*/


///////////////////////////////////////////////////////////////////////////////////
int16_t AcX, AcY, AcZ, Tmp, GyX, GyY, GyZ;
const int MPU = 0x68;  //MPU 6050 의 I2C 기본 주소
int speakerpin = 7;
long count = 0;
bool checkCount = true;
char inString = 'a';
//int inputPin = 2;   // choose input pin 7 for the push button
//char charCount ="";
//long timer = 0;
//long gyroval = 0;

/*graphic library constructor*/
U8G2_SSD1327_WS_128X128_1_4W_SW_SPI u8g2(U8G2_R0, /* clock=*/ 12, /* data=*/ 11, /* cs=*/ 10, /* dc=*/ 9, /* reset=*/ 8);
SoftwareSerial BTSerial(2, 3); //RX,TX
/*image coordinate*/

#define eyes_width 16       //left eye coordinate  x,y(27,17)
#define eyes_height 43       //right eye coordinate x,y(85,17)
#define smile_mouth_width 94   //smile_mouth coordinate  x,y(17,74)
#define smile_mouth_height 37
#define bad_mouth_width 94     //bad_mouth coordinate  x,y(17,74)
#define bad_mouth_height 37
#define bpm_width 93       //bpm coordinate  x,y(17,48)
#define bpm_height 31
#define alram_width 100      //alram coordinate  x,y(14,8)
#define alram_height 112
#define dummbel_image_width 110  //dummbel coordinate  x,y(9,9)
#define dummbel_image_height 110
#define complete_width 81    //complete coordinate  x,y(29,5)
#define complete_height 90
#define setting_image_width 102  //setting coordinate  x,y(13,13)
#define setting_image_height 102
#define metronome_width 128    //metronome coordinate  x,y(0,25)
#define metronome_height 80
#define mission_width 107    //mission coordinate  x,y(5,5)
#define mission_height 107
#define rest_dot_width 30    //rest_dot1 coordinate  x,y(6,49)
#define rest_dot_height 30     //rest_dot2 coordinate  x,y(49,49)
   //rest_dot3 coordinate  x,y(92,49)

/*graphic image_data_array*/
static const unsigned char eyes_bits[] U8X8_PROGMEM = {
   0xc0, 0x07, 0xf0, 0x1f, 0xf8, 0x3f, 0xfc, 0x7f, 0xfe, 0xff, 0xfe, 0xff,
   0xff, 0xff, 0xff, 0xff, 0xff, 0xff, 0xff, 0xff, 0xff, 0xff, 0xff, 0xff,
   0xff, 0xff, 0xff, 0xff, 0xff, 0xff, 0xff, 0xff, 0xff, 0xff, 0xff, 0xff,
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   0xe0, 0x0f };
static const unsigned char smile_mouth_bits[] U8X8_PROGMEM = {
   0xfe, 0x03, 0x00, 0x00, 0x00, 0x00, 0x00, 0x00, 0x00, 0x00, 0xf0, 0x1f,
   0xff, 0x07, 0x00, 0x00, 0x00, 0x00, 0x00, 0x00, 0x00, 0x00, 0xf8, 0x3f,
   0xff, 0x0f, 0x00, 0x00, 0x00, 0x00, 0x00, 0x00, 0x00, 0x00, 0xfc, 0x3f,
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   0x00, 0x00, 0x00, 0x00, 0x80, 0xff, 0x7f, 0x00, 0x00, 0x00, 0x00, 0x00 };
static const unsigned char bad_mouth_bits[] U8X8_PROGMEM = {
   0x00, 0x00, 0x00, 0x00, 0xc0, 0xff, 0xff, 0x00, 0x00, 0x00, 0x00, 0x00,
   0x00, 0x00, 0x00, 0x00, 0xfe, 0xff, 0xff, 0x1f, 0x00, 0x00, 0x00, 0x00,
   0x00, 0x00, 0x00, 0xe0, 0xff, 0xff, 0xff, 0xff, 0x01, 0x00, 0x00, 0x00,
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   0xfc, 0x01, 0x00, 0x00, 0x00, 0x00, 0x00, 0x00, 0x00, 0x00, 0xe0, 0x0f };
static const unsigned char bpm_bits[] U8X8_PROGMEM = {
   0xff, 0xff, 0x03, 0xe0, 0xff, 0x3f, 0x00, 0xfe, 0x7f, 0xc0, 0xff, 0x1f,
   0xff, 0xff, 0x1f, 0xe0, 0xff, 0xff, 0x01, 0xfe, 0x7f, 0xc0, 0xff, 0x1f,
   0xff, 0xff, 0x7f, 0xe0, 0xff, 0xff, 0x07, 0xfe, 0x7f, 0xc0, 0xff, 0x1f,
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   0xff, 0xff, 0x1f, 0xe0, 0x7f, 0x00, 0x00, 0xfe, 0xc7, 0x7f, 0xfc, 0x1f };
static const unsigned char alram_bits[] U8X8_PROGMEM = {
   0x00, 0x00, 0x00, 0x00, 0x00, 0xc0, 0x3f, 0x00, 0x00, 0x00, 0x00, 0x00,
   0x00, 0x00, 0x00, 0x00, 0x00, 0x00, 0xf8, 0xff, 0x01, 0x00, 0x00, 0x00,
   0x00, 0x00, 0x00, 0x00, 0x00, 0x00, 0x00, 0xfe, 0xff, 0x07, 0x00, 0x00,
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   0x00, 0x00, 0x00, 0x00 };
static const unsigned char dummbel_image_bits[] U8X8_PROGMEM = {
   0x00, 0x00, 0x00, 0x00, 0x00, 0x00, 0x00, 0x00, 0x00, 0xc0, 0x01, 0x00,
   0x00, 0x00, 0x00, 0x00, 0x00, 0x00, 0x00, 0x00, 0x00, 0x00, 0x00, 0xe0,
   0x07, 0x00, 0x00, 0x00, 0x00, 0x00, 0x00, 0x00, 0x00, 0x00, 0x00, 0x00,
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   0x00, 0x00, 0x00, 0x00 };
static const unsigned char complete_bits[] U8X8_PROGMEM = {
   0x00, 0x00, 0x00, 0x00, 0x00, 0x00, 0x00, 0x00, 0x00, 0x30, 0x00, 0x00,
   0x00, 0x00, 0x00, 0x00, 0x00, 0x00, 0x00, 0x00, 0x78, 0x00, 0x00, 0x00,
   0x00, 0x00, 0x00, 0x00, 0x00, 0x00, 0x00, 0xf8, 0x00, 0x00, 0x00, 0x00,
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   0xff, 0xff, 0xff, 0x03, 0x00, 0x00 };
static const unsigned char setting_image_bits[] U8X8_PROGMEM = {
   0x00, 0x00, 0x00, 0x00, 0x00, 0xf0, 0xff, 0x03, 0x00, 0x00, 0x00, 0x00,
   0x00, 0x00, 0x00, 0x00, 0x00, 0x00, 0xf0, 0xff, 0x03, 0x00, 0x00, 0x00,
   0x00, 0x00, 0x00, 0x00, 0x00, 0x00, 0x00, 0xf0, 0xff, 0x03, 0x00, 0x00,
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   0x03, 0x00, 0x00, 0x00, 0x00, 0x00 };
static const unsigned char metronome_bits[] U8X8_PROGMEM = {
   0x00, 0x00, 0x00, 0x00, 0x00, 0x00, 0x00, 0x00, 0x00, 0x80, 0x01, 0x00,
   0x00, 0x00, 0x00, 0x00, 0x00, 0x00, 0x00, 0x00, 0x00, 0x00, 0x00, 0x00,
   0x00, 0x80, 0x01, 0x00, 0x00, 0x00, 0x00, 0x00, 0x00, 0x00, 0x00, 0x00,
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   0x03, 0x00, 0x00, 0x00, 0x00, 0x00, 0x00, 0x00 };
static const unsigned char mission_bits[] U8X8_PROGMEM = {
   0x00, 0x00, 0x00, 0x00, 0x00, 0x00, 0xfe, 0x03, 0x00, 0x00, 0x00, 0x00,
   0x06, 0x00, 0x00, 0x00, 0x00, 0x00, 0x00, 0xfc, 0xff, 0xff, 0x01, 0x00,
   0x00, 0x00, 0x0f, 0x00, 0x00, 0x00, 0x00, 0x00, 0xc0, 0xff, 0xff, 0xff,
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   0x00, 0x80, 0xff, 0x0f, 0x00, 0x00, 0x00, 0x00, 0x00, 0x00 };
static const unsigned char rest_dot_bits[] U8X8_PROGMEM = {
   0x00, 0xf8, 0x0f, 0x00, 0x00, 0xff, 0x3f, 0x00, 0x80, 0xff, 0xff, 0x00,
   0xe0, 0xff, 0xff, 0x01, 0xf0, 0xff, 0xff, 0x03, 0xf8, 0xff, 0xff, 0x07,
   0xf8, 0xff, 0xff, 0x0f, 0xfc, 0xff, 0xff, 0x0f, 0xfc, 0xff, 0xff, 0x1f,
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   0x80, 0xff, 0xff, 0x00, 0x00, 0xff, 0x3f, 0x00, 0x00, 0xf8, 0x0f, 0x00 };

/*setup function*/
void setup() {
  u8g2.begin();                         // u8g2 library setting
  u8g2.setFont(u8g2_font_ncenB18_tr);   // choose a suitable font

  //Wire_setting
  Wire.begin();                // Wire library setting
  Wire.beginTransmission(MPU); // MPU data transmission begin
  Wire.write(0x6B);            // PWR_MGMT_1 register
  Wire.write(0);               // MPU-6050 begin mode change
  Wire.endTransmission(true);  // MPU-6050 transmission end

  //BLE_setting,Serial_setting
  BTSerial.begin(9600);        //BLE library setting
  Serial.begin(9600);          //Serial library setting


  draw_smile();      //activate_image or LOGO image

  //  u8g2.setFont(u8g2_font_ncenB14_tr);
  //  u8g2.drawStr(10,128,"Hello World!");
  //  delay(2000);

  delay(2000);
}

void loop() {
  int system_status = SYSTEM_STATUS_READY;

  ble_check(&system_status);  //
  ready_count(&system_status);//'0'입력시 진행 
  if (system_status == SYSTEM_STATUS_PLAYING)
  {
    Serial.println("a if문 들어옴");
    a_position_check(&system_status);
    
    delay(1000);
    if (system_status == SYSTEM_STATUS_PLAYING2)
    {
      Serial.println("b if문 들어옴");
      b_position_check(&system_status);
      
      delay(1000);
      if (system_status == SYSTEM_STATUS_PLAYING3)
      {
        Serial.println("c if문 들어옴");
        c_position_check(&system_status);
        
        delay(1000);
        if (system_status == SYSTEM_STATUS_END)
        {
          Serial.println(" if문 들어옴");
          system_status = SYSTEM_STATUS_READY;
          delay(3000);
        }
      }
    }
  }
}

/*draw_fuction list///////////////////////////////////*/
void draw_smile(void) {
  u8g2.firstPage();
  do {
    u8g2.drawXBMP(27, 17, eyes_width, eyes_height, eyes_bits);
    u8g2.drawXBMP(85, 17, eyes_width, eyes_height, eyes_bits);
    u8g2.drawXBMP(17, 74, smile_mouth_width, smile_mouth_height, smile_mouth_bits);
//    u8g2.setFont(u8g2_font_ncenB14_tr);   // choose a suitable font           //font setting
//    u8g2.drawStr(5, 64, "Health Mile!");    // write something to the internal //image + text
  } while (u8g2.nextPage());
}
void draw_bad(void) {
  u8g2.firstPage();
  do {
    u8g2.drawXBMP(27, 17, eyes_width, eyes_height, eyes_bits);
    u8g2.drawXBMP(85, 17, eyes_width, eyes_height, eyes_bits);
    u8g2.drawXBMP(17, 74, bad_mouth_width, bad_mouth_height, bad_mouth_bits);
  } while (u8g2.nextPage());
}
void draw_complete(void) {
  u8g2.firstPage();
  do {
    u8g2.drawXBMP(29, 5, complete_width, complete_height, complete_bits);
  } while (u8g2.nextPage());
}
void draw_setting(void) {
  u8g2.firstPage();
  do {
    u8g2.drawXBMP(13, 13, setting_image_width, setting_image_height, setting_image_bits);
  } while (u8g2.nextPage());
}
void draw_bpm(void) {
  u8g2.firstPage();
  do {
    u8g2.drawXBMP(17, 48, bpm_width, bpm_height, bpm_bits);
  } while (u8g2.nextPage());
}
void draw_dummbel(void) {
  u8g2.firstPage();
  do {
    u8g2.drawXBMP(9, 9, dummbel_image_width, dummbel_image_height, dummbel_image_bits);
  } while (u8g2.nextPage());
}
void draw_metronome(void) {
  u8g2.firstPage();
  do {
    u8g2.drawXBMP(0, 25, metronome_width, metronome_height, metronome_bits);
  } while (u8g2.nextPage());
}
void draw_mission(void) {
  u8g2.firstPage();
  do {
    u8g2.drawXBMP(6, 6, mission_width, mission_height, mission_bits);
  } while (u8g2.nextPage());
}
void draw_text(const uint8_t* font,const char* text, int x, int y) { //text, 좌표x, 좌표y
  u8g2.firstPage();
  do {
    u8g2.setFont(font);   // choose a suitable font
    u8g2.drawStr(x, y, text);    // write something to the internal 
  } while (u8g2.nextPage());
}
void draw_value(const uint8_t* font, int var, int x, int y) {
  u8g2.firstPage();
  do {
    u8g2.setFont(font); 
    u8g2.setCursor(x, y); //coordination need to be changed
    u8g2.print(var);       // write something to the internal 
  } while (u8g2.nextPage());
}
void draw_alram(void) {
  u8g2.firstPage();
  do {
    u8g2.drawXBMP(14, 8, alram_width, alram_height, alram_bits);
  } while (u8g2.nextPage());
}
void draw_rest(void) {
  for (int i = 0; i <= 2; i++) {
    u8g2.firstPage();
    do {
      u8g2.drawXBMP(6 + 43 * i, 49, rest_dot_width, rest_dot_height, rest_dot_bits);
    } while (u8g2.nextPage());
    delay(500);
  }
}
void draw_pause(void) {
  u8g2.firstPage();
  do {
    u8g2.drawBox(26, 23, 30, 80);
    u8g2.drawBox(73, 23, 30, 80);
  } while (u8g2.nextPage());
}
void draw_wave(void) {
  for (int i = 0; i < 5; i++) {
    u8g2.firstPage();
    do {
      u8g2.drawCircle(64, 64, 10 + 15 * i, U8G2_DRAW_ALL);
    } while (u8g2.nextPage());
  }
  for (int i = 0; i < 5; i++) {
    u8g2.firstPage();
    do {
      u8g2.drawCircle(64, 64, 70 - 15 * i, U8G2_DRAW_ALL);
    } while (u8g2.nextPage());
  }
}
/////////////////////////////////////////////////////////
void writeString(String stringData) { // Used to serially push out a String with Serial.write()

  for (int i = 0; i < stringData.length(); i++)
  {
    BTSerial.write(stringData[i]);   // Push each char 1 by 1 on each loop pass
  }

}// end writeString
void ble_check(int* system_status) {
  while (true) {
    if (*system_status == SYSTEM_STATUS_READY) {
      draw_smile();
      if (BTSerial.available()) {
        int inChar = BTSerial.read();

        if (isDigit(inChar)) {
          // convert the incoming byte to a char and add it to the string:
          inString = (char)inChar;
          if (inString == '0') {
            
            *system_status = SYSTEM_STATUS_READY;
            return;
          }
          else if (inString == '1') {
            

            *system_status = SYSTEM_STATUS_COUNT;
            return;
          }
        }
      }
    }
    else if (*system_status == SYSTEM_STATUS_PLAYING || *system_status == SYSTEM_STATUS_PLAYING2 || *system_status == SYSTEM_STATUS_PLAYING3) {
      delay(1000);
      *system_status = SYSTEM_STATUS_READY;
      return;
    }
    else return;
  }
}
void ready_count(int* system_status) {
  Serial.println("카운트들어옴");
  if (*system_status == SYSTEM_STATUS_COUNT) {
    draw_dummbel();
    count = 3;
    Serial.println(count);
    draw_value(u8g2_font_logisoso92_tn,count,35,110);
    delay(900);
    count = 2;
    Serial.println(count);
    draw_value(u8g2_font_logisoso92_tn,count,35,110);
    
    delay(900);
    count = 1;
    Serial.println(count);
    draw_value(u8g2_font_logisoso92_tn,count,35,110);
    
    delay(900);
    
    count = 0;
    draw_dummbel();
    delay(1500);
    *system_status = SYSTEM_STATUS_PLAYING;
    return;
  }
}
void a_position_check(int* system_status) {
  unsigned long start_time = millis();
  while (true) {
    if (BTSerial.available()) {
      int inChar = BTSerial.read();

      if (isDigit(inChar)) {
        // convert the incoming byte to a char and add it to the string:
        inString = (char)inChar;
        if (inString == '0') {
          
          *system_status = SYSTEM_STATUS_READY;
          return;
        }
      }
    }
    unsigned long cur_time = millis();
    
    //    Serial.println((cur_time - start_time)%1500);
    //        if(((cur_time - start_time)%1500)<=50)
    //        {
    //          tone(speakerpin, 250, 100);
    //        }

    Wire.beginTransmission(MPU);    //데이터 전송시작
    Wire.write(0x3B);               // register 0x3B (ACCEL_XOUT_H), 큐에 데이터 기록
    Wire.endTransmission(false);    //연결유지
    Wire.requestFrom(MPU, 6, true);  //MPU에 데이터 요청


    //데이터 한 바이트 씩 읽어서 반환
    AcX = Wire.read() << 8 | Wire.read();  // 0x3B (ACCEL_XOUT_H) & 0x3C (ACCEL_XOUT_L)    
    AcY = Wire.read() << 8 | Wire.read();  // 0x3D (ACCEL_YOUT_H) & 0x3E (ACCEL_YOUT_L)
    AcZ = Wire.read() << 8 | Wire.read();  // 0x3F (ACCEL_ZOUT_H) & 0x40 (ACCEL_ZOUT_L)
    //Tmp = Wire.read() << 8 | Wire.read();  // 0x41 (TEMP_OUT_H) & 0x42 (TEMP_OUT_L)
    //GyX = Wire.read() << 8 | Wire.read();  // 0x43 (GYRO_XOUT_H) & 0x44 (GYRO_XOUT_L)
    //GyY = Wire.read() << 8 | Wire.read();  // 0x45 (GYRO_YOUT_H) & 0x46 (GYRO_YOUT_L)
    //GyZ = Wire.read() << 8 | Wire.read();  // 0x47 (GYRO_ZOUT_H) & 0x48 (GYRO_ZOUT_L)


    float RADIAN_TO_DEGREES = 180 / 3.14139;
    float val_y = atan(AcX / sqrt(pow(AcY, 2) + pow(AcZ, 2))) * RADIAN_TO_DEGREES;
    //writeString(val_y);
    //float val_x = atan(AcY/sqrt(pow(AcX,2) + pow(AcZ,2))) * RADIAN_TO_DEGREES;

    //시리얼 모니터에 출력
    //Serial.print("AcX = "); 
    //Serial.println(val_y);
    //Serial.print(" | AcY = "); Serial.println(val_x);
    //Serial.print(" | AcZ = "); Serial.println(AcZ);
    //Serial.print(" | Tmp = "); Serial.print(Tmp/340.00+36.53);  
    //Serial.print(" | GyX = "); Serial.println(GyX);
    //Serial.print(" | GyY = "); Serial.print(GyY);
    //Serial.print(" | GyZ = "); Serial.println(GyZ);

    if (val_y < 0) {
      if (checkCount == true) {
        checkCount = false;
        count = count + 1;
        draw_value(u8g2_font_logisoso92_tn,count,35,110);
        
        //          char ShowData = count;
        //          BTSerial.write(ShowData);
        writeString("count");
      }
    }

    if (val_y > 80) {
      if (checkCount == false) {
        checkCount = true;
      } 
    }
        if (count == 3) {
          count = 0;

          delay(1500);
          draw_smile();


          
          *system_status = SYSTEM_STATUS_PLAYING2;
          delay(2000);
          writeString("next");
          return;
        }
      
    }
  }
void b_position_check(int* system_status) {
  while (true) {
    if (BTSerial.available()) {
      int inChar = BTSerial.read();

      if (isDigit(inChar)) {
        // convert the incoming byte to a char and add it to the string:
        inString = (char)inChar;
        if (inString == '0') {
          
          *system_status = SYSTEM_STATUS_READY;
          return;
        }
      }
    }

    Wire.beginTransmission(MPU);    //데이터 전송시작
    Wire.write(0x3B);               // register 0x3B (ACCEL_XOUT_H), 큐에 데이터 기록
    Wire.endTransmission(false);    //연결유지
    Wire.requestFrom(MPU, 6, true);  //MPU에 데이터 요청
    

    //데이터 한 바이트 씩 읽어서 반환
    AcX = Wire.read() << 8 | Wire.read();  // 0x3B (ACCEL_XOUT_H) & 0x3C (ACCEL_XOUT_L)    
    AcY = Wire.read() << 8 | Wire.read();  // 0x3D (ACCEL_YOUT_H) & 0x3E (ACCEL_YOUT_L)
    AcZ = Wire.read() << 8 | Wire.read();  // 0x3F (ACCEL_ZOUT_H) & 0x40 (ACCEL_ZOUT_L)
    //Tmp = Wire.read() << 8 | Wire.read();  // 0x41 (TEMP_OUT_H) & 0x42 (TEMP_OUT_L)
    //GyX = Wire.read() << 8 | Wire.read();  // 0x43 (GYRO_XOUT_H) & 0x44 (GYRO_XOUT_L)
    //GyY = Wire.read() << 8 | Wire.read();  // 0x45 (GYRO_YOUT_H) & 0x46 (GYRO_YOUT_L)
    //GyZ = Wire.read() << 8 | Wire.read();  // 0x47 (GYRO_ZOUT_H) & 0x48 (GYRO_ZOUT_L)


    float RADIAN_TO_DEGREES = 180 / 3.14139;
    float val_y = atan(AcX / sqrt(pow(AcY, 2) + pow(AcZ, 2))) * RADIAN_TO_DEGREES;
    //writeString(val_y);
    //float val_x = atan(AcY/sqrt(pow(AcX,2) + pow(AcZ,2))) * RADIAN_TO_DEGREES;

    //시리얼 모니터에 출력
    //Serial.print("AcX = "); 
    //Serial.println(val_y);
    //Serial.print(" | AcY = "); Serial.println(val_x);
    //Serial.print(" | AcZ = "); Serial.println(AcZ);
    //Serial.print(" | Tmp = "); Serial.print(Tmp/340.00+36.53);  
    //Serial.print(" | GyX = "); Serial.println(GyX);
    //Serial.print(" | GyY = "); Serial.print(GyY);
    //Serial.print(" | GyZ = "); Serial.println(GyZ);

    if (val_y < 0) {
      if (checkCount == true) {
        checkCount = false;
        count = count + 1;
        draw_value(u8g2_font_logisoso92_tn,count,35,110);
        //          char ShowData = count;
        //          BTSerial.write(ShowData);
        writeString("count");
      }
    }

    if (val_y > 60) {
      if (checkCount == false) {
        checkCount = true;
      }
    }
        if (count == 3) {
          count = 0;

          delay(1500);
          draw_smile();


          *system_status = SYSTEM_STATUS_PLAYING3;
          delay(2000);
          writeString("next");
          return; 
      }
    
  }
}
void c_position_check(int* system_status) {
  while (true) {
    if (BTSerial.available()) {
      int inChar = BTSerial.read();

      if (isDigit(inChar)) {
        // convert the incoming byte to a char and add it to the string:
        inString = (char)inChar;
        if (inString == '0') {
          tone(speakerpin, 500, 500);  //500: 음의 높낮이(주파수), 1000: 음의 지속시간(1초)
          *system_status = SYSTEM_STATUS_READY;
          return;
        }
      }
    }
    Serial.println("c들어옴");
    Wire.beginTransmission(MPU);    //데이터 전송시작
    Wire.write(0x3B);               // register 0x3B (ACCEL_XOUT_H), 큐에 데이터 기록
    Wire.endTransmission(false);    //연결유지
    Wire.requestFrom(MPU, 6, true);  //MPU에 데이터 요청


    //데이터 한 바이트 씩 읽어서 반환
    AcX = Wire.read() << 8 | Wire.read();  // 0x3B (ACCEL_XOUT_H) & 0x3C (ACCEL_XOUT_L)    
    AcY = Wire.read() << 8 | Wire.read();  // 0x3D (ACCEL_YOUT_H) & 0x3E (ACCEL_YOUT_L)
    AcZ = Wire.read() << 8 | Wire.read();  // 0x3F (ACCEL_ZOUT_H) & 0x40 (ACCEL_ZOUT_L)
    //Tmp = Wire.read() << 8 | Wire.read();  // 0x41 (TEMP_OUT_H) & 0x42 (TEMP_OUT_L)
    //GyX = Wire.read() << 8 | Wire.read();  // 0x43 (GYRO_XOUT_H) & 0x44 (GYRO_XOUT_L)
    //GyY = Wire.read() << 8 | Wire.read();  // 0x45 (GYRO_YOUT_H) & 0x46 (GYRO_YOUT_L)
    //GyZ = Wire.read() << 8 | Wire.read();  // 0x47 (GYRO_ZOUT_H) & 0x48 (GYRO_ZOUT_L)


    float RADIAN_TO_DEGREES = 180 / 3.14139;
    float val_y = atan(AcX / sqrt(pow(AcY, 2) + pow(AcZ, 2))) * RADIAN_TO_DEGREES;
    //writeString(val_y);
    //float val_x = atan(AcY/sqrt(pow(AcX,2) + pow(AcZ,2))) * RADIAN_TO_DEGREES;

    //시리얼 모니터에 출력
    //Serial.print("AcX = "); 
    //Serial.println(val_y);
    //Serial.print(" | AcY = "); Serial.println(val_x);
    //Serial.print(" | AcZ = "); Serial.println(AcZ);
    //Serial.print(" | Tmp = "); Serial.print(Tmp/340.00+36.53);  
    //Serial.print(" | GyX = "); Serial.println(GyX);
    //Serial.print(" | GyY = "); Serial.print(GyY);
    //Serial.print(" | GyZ = "); Serial.println(GyZ);

    if (val_y > 70) {
      if (checkCount == true) {
        checkCount = false;
        count = count + 1;
        draw_value(u8g2_font_logisoso92_tn,count,35,110);
        //          char ShowData = count;
        //          BTSerial.write(ShowData);
        writeString("count");
      }
    }

      if (val_y < 0) {
      if (checkCount == false) {
        checkCount = true;
      }
    }
        if (count == 3) {
          count = 0;

          delay(1500);
          draw_smile();
    
          *system_status = SYSTEM_STATUS_END;
          delay(2000);
          writeString("next");
          return; 
      }
    
  }
}

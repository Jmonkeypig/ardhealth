
#include <Arduino.h>
#include <U8g2lib.h>

#ifdef U8X8_HAVE_HW_SPI
#include <SPI.h>
#endif
#ifdef U8X8_HAVE_HW_I2C
#include <Wire.h>
#endif


U8G2_SSD1327_WS_128X128_1_4W_SW_SPI u8g2(U8G2_R0, /* clock=*/ 12, /* data=*/ 11, /* cs=*/ 10, /* dc=*/ 9, /* reset=*/ 8);
//display constructor
//controler : SSD1327
//product : waveshare
//interface : SPI
//PIN setting

#define eye_width 16 //
#define eye_height 43//
//left  eye coordinate x,y(27,17)
//right eye coordinate x,y(85,17)
static const unsigned char eye_bits[] U8X8_PROGMEM = {
   0xc0, 0x07, 0xf0, 0x1f, 0xf8, 0x3f, 0xfc, 0x7f, 0xfe, 0xff, 0xfe, 0xff,
   0xff, 0xff, 0xff, 0xff, 0xff, 0xff, 0xff, 0xff, 0xff, 0xff, 0xff, 0xff,
   0xff, 0xff, 0xff, 0xff, 0xff, 0xff, 0xff, 0xff, 0xff, 0xff, 0xff, 0xff,
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   0xe0, 0x0f };

#define smile_mouth_width 94
#define smile_mouth_height 37
//smile_mouth coordinate  x,y(17,74)

static const unsigned char smile_mouth_bits[] U8X8_PROGMEM = {
   0xfe, 0x03, 0x00, 0x00, 0x00, 0x00, 0x00, 0x00, 0x00, 0x00, 0xf0, 0x1f,
   0xff, 0x07, 0x00, 0x00, 0x00, 0x00, 0x00, 0x00, 0x00, 0x00, 0xf8, 0x3f,
   0xff, 0x0f, 0x00, 0x00, 0x00, 0x00, 0x00, 0x00, 0x00, 0x00, 0xfc, 0x3f,
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   0x00, 0x00, 0x00, 0x00, 0x80, 0xff, 0x7f, 0x00, 0x00, 0x00, 0x00, 0x00 };

#define bad_mouth_width 94
#define bad_mouth_height 37
//bad_mouth coordinate  x,y(17,74)
static const unsigned char bad_mouth_bits[] U8X8_PROGMEM = {
   0x00, 0x00, 0x00, 0x00, 0xc0, 0xff, 0xff, 0x00, 0x00, 0x00, 0x00, 0x00,
   0x00, 0x00, 0x00, 0x00, 0xfe, 0xff, 0xff, 0x1f, 0x00, 0x00, 0x00, 0x00,
   0x00, 0x00, 0x00, 0xe0, 0xff, 0xff, 0xff, 0xff, 0x01, 0x00, 0x00, 0x00,
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   0xfc, 0x01, 0x00, 0x00, 0x00, 0x00, 0x00, 0x00, 0x00, 0x00, 0xe0, 0x0f };




#define bpm_width 93 
#define bpm_height 31
//bpm coordinate  x,y(17,48)
static const unsigned char bpm_bits[] U8X8_PROGMEM = {
   0xff, 0xff, 0x03, 0xe0, 0xff, 0x3f, 0x00, 0xfe, 0x7f, 0xc0, 0xff, 0x1f,
   0xff, 0xff, 0x1f, 0xe0, 0xff, 0xff, 0x01, 0xfe, 0x7f, 0xc0, 0xff, 0x1f,
   0xff, 0xff, 0x7f, 0xe0, 0xff, 0xff, 0x07, 0xfe, 0x7f, 0xc0, 0xff, 0x1f,
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   0xff, 0xff, 0x1f, 0xe0, 0x7f, 0x00, 0x00, 0xfe, 0xc7, 0x7f, 0xfc, 0x1f };

#define alram_width 100
#define alram_height 112
//alram coordinate  x,y(14,8)
static const unsigned char alram_bits [] U8X8_PROGMEM = {
   0x00, 0x00, 0x00, 0x00, 0x00, 0xc0, 0x3f, 0x00, 0x00, 0x00, 0x00, 0x00,
   0x00, 0x00, 0x00, 0x00, 0x00, 0x00, 0xf8, 0xff, 0x01, 0x00, 0x00, 0x00,
   0x00, 0x00, 0x00, 0x00, 0x00, 0x00, 0x00, 0xfe, 0xff, 0x07, 0x00, 0x00,
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   0x00, 0x00, 0x00, 0x00 };

#define dummbel_image_width 110
#define dummbel_image_height 110
//dummbel coordinate  x,y(9,9)
static const unsigned char dummbel_image_bits[] U8X8_PROGMEM = {
   0x00, 0x00, 0x00, 0x00, 0x00, 0x00, 0x00, 0x00, 0x00, 0xc0, 0x01, 0x00,
   0x00, 0x00, 0x00, 0x00, 0x00, 0x00, 0x00, 0x00, 0x00, 0x00, 0x00, 0xe0,
   0x07, 0x00, 0x00, 0x00, 0x00, 0x00, 0x00, 0x00, 0x00, 0x00, 0x00, 0x00,
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   0x00, 0x00, 0x00, 0x00 };

   #define complete_width 81
   #define complete_height 90
   //complete coordinate  x,y(29,5)
static const unsigned char complete_bits[] U8X8_PROGMEM = {
   0x00, 0x00, 0x00, 0x00, 0x00, 0x00, 0x00, 0x00, 0x00, 0x30, 0x00, 0x00,
   0x00, 0x00, 0x00, 0x00, 0x00, 0x00, 0x00, 0x00, 0x78, 0x00, 0x00, 0x00,
   0x00, 0x00, 0x00, 0x00, 0x00, 0x00, 0x00, 0xf8, 0x00, 0x00, 0x00, 0x00,
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   0xff, 0xff, 0xff, 0x03, 0x00, 0x00 };

#define setting_image_width 102
#define setting_image_height 102
//setting coordinate  x,y(13,13)
static const unsigned char setting_image_bits[] U8X8_PROGMEM = {
   0x00, 0x00, 0x00, 0x00, 0x00, 0xf0, 0xff, 0x03, 0x00, 0x00, 0x00, 0x00,
   0x00, 0x00, 0x00, 0x00, 0x00, 0x00, 0xf0, 0xff, 0x03, 0x00, 0x00, 0x00,
   0x00, 0x00, 0x00, 0x00, 0x00, 0x00, 0x00, 0xf0, 0xff, 0x03, 0x00, 0x00,
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   0x03, 0x00, 0x00, 0x00, 0x00, 0x00 };

#define metronome_width 128
#define metronome_height 80
//metronome coordinate  x,y(0,25)
static const unsigned char metronome_bits[] U8X8_PROGMEM = {
   0x00, 0x00, 0x00, 0x00, 0x00, 0x00, 0x00, 0x00, 0x00, 0x80, 0x01, 0x00,
   0x00, 0x00, 0x00, 0x00, 0x00, 0x00, 0x00, 0x00, 0x00, 0x00, 0x00, 0x00,
   0x00, 0x80, 0x01, 0x00, 0x00, 0x00, 0x00, 0x00, 0x00, 0x00, 0x00, 0x00,
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   0x03, 0x00, 0x00, 0x00, 0x00, 0x00, 0x00, 0x00 };

#define mission_width 107
#define mission_height 107
//mission coordinate  x,y(5,5)
static const unsigned char mission_bits[] U8X8_PROGMEM = {
   0x00, 0x00, 0x00, 0x00, 0x00, 0x00, 0xfe, 0x03, 0x00, 0x00, 0x00, 0x00,
   0x06, 0x00, 0x00, 0x00, 0x00, 0x00, 0x00, 0xfc, 0xff, 0xff, 0x01, 0x00,
   0x00, 0x00, 0x0f, 0x00, 0x00, 0x00, 0x00, 0x00, 0xc0, 0xff, 0xff, 0xff,
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   0x00, 0x80, 0xff, 0x0f, 0x00, 0x00, 0x00, 0x00, 0x00, 0x00 };

#define rest_dot_width 30
#define rest_dot_height 30
//rest_dot1 coordinate  x,y(6,49)
//rest_dot2 coordinate  x,y(49,49)
//rest_dot3 coordinate  x,y(92,49)
static const unsigned char rest_dot_bits[] U8X8_PROGMEM = {
   0x00, 0xf8, 0x0f, 0x00, 0x00, 0xff, 0x3f, 0x00, 0x80, 0xff, 0xff, 0x00,
   0xe0, 0xff, 0xff, 0x01, 0xf0, 0xff, 0xff, 0x03, 0xf8, 0xff, 0xff, 0x07,
   0xf8, 0xff, 0xff, 0x0f, 0xfc, 0xff, 0xff, 0x0f, 0xfc, 0xff, 0xff, 0x1f,
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   0x80, 0xff, 0xff, 0x00, 0x00, 0xff, 0x3f, 0x00, 0x00, 0xf8, 0x0f, 0x00 };

//draw_fuction list
void draw_smile(void) {
 u8g2.firstPage();
  do {
    u8g2.drawXBMP(27,17, eye_width, eye_height , eye_bits); //left eye
    u8g2.drawXBMP(85,17, eye_width, eye_height , eye_bits); //right eye
    u8g2.drawXBMP(17,74, smile_mouth_width, smile_mouth_height , smile_mouth_bits); // smile mouth
  } while ( u8g2.nextPage() );
}
void draw_bad(void) {
 u8g2.firstPage();
  do {
    u8g2.drawXBMP(27,17, eye_width, eye_height , eye_bits);
    u8g2.drawXBMP(85,17, eye_width, eye_height , eye_bits);
    u8g2.drawXBMP(17,74, bad_mouth_width, bad_mouth_height , bad_mouth_bits);
  } while ( u8g2.nextPage() );
}
void draw_complete(void){
    u8g2.firstPage();
  do {
    u8g2.drawXBMP(29,5, complete_width, complete_height , complete_bits);
  } while ( u8g2.nextPage() );
}
void draw_setting(void){
     u8g2.firstPage();
  do {
    u8g2.drawXBMP(13,13, setting_image_width, setting_image_height , setting_image_bits);
  } while ( u8g2.nextPage() );
}
void draw_bpm(void){
   u8g2.firstPage();
  do {
    u8g2.drawXBMP(17,48, bpm_width, bpm_height , bpm_bits);
  } while ( u8g2.nextPage() );
}
void draw_dummbel(void){
   u8g2.firstPage();
  do {
  u8g2.drawXBMP(9,9,dummbel_image_width, dummbel_image_height, dummbel_image_bits);
   } while ( u8g2.nextPage() );
}
void draw_metronome(void){
     u8g2.firstPage();
  do {
  u8g2.drawXBMP(0,25,metronome_width, metronome_height, metronome_bits);
   } while ( u8g2.nextPage() );
}
void draw_mission(void){
  u8g2.firstPage();
  do {
  u8g2.drawXBMP(6,6,mission_width, mission_height, mission_bits);
   } while ( u8g2.nextPage() );
}
void draw_alram(void){
   u8g2.firstPage();
  do {
  u8g2.drawXBMP(14,8,alram_width, alram_height, alram_bits);
   } while ( u8g2.nextPage() );
}

void draw_rest(void){
  for(int i = 0; i <= 2; i++){
   u8g2.firstPage();
  do {
  u8g2.drawXBMP(6+43*i,49,rest_dot_width, rest_dot_height, rest_dot_bits);
   } while ( u8g2.nextPage() );
   delay(500);
  } 
}
void draw_pause(void) //
{
  u8g2.firstPage();
  do {
//  u8g2.drawXBMP(26,23,pause_dot_width, pause_dot_height, rest_dot_bits); //기존 이미지 깨짐
//  u8g2.drawXBMP(73,23,pause_dot_width, pause_dot_height, rest_dot_bits); //수정해도 안됨
    u8g2.drawBox(26,23, 30, 80); //사각형 그리기로 대체
    u8g2.drawBox(73,23, 30, 80); //사각형 그리기로 대체
   } while ( u8g2.nextPage() );
}
void draw_wave(void)
{
 for(int i = 0; i < 5; i++){
   u8g2.firstPage();
  do {
  u8g2.drawCircle(64,64,10+15*i,U8G2_DRAW_ALL);
   } while ( u8g2.nextPage() );
  } 
  for(int i = 0; i < 5; i++){
   u8g2.firstPage();
  do {
  u8g2.drawCircle(64,64,70-15*i,U8G2_DRAW_ALL);
   } while ( u8g2.nextPage() );
  }
}


void setup(void) {
  u8g2.begin();  
  u8g2.setContrast(255);
}

void loop(void) {

//200ms delay ordered image print
draw_bpm();
delay(200);
draw_setting();
delay(200);
draw_bad();
delay(200);
draw_smile();
delay(200);
draw_dummbel();
delay(200);
draw_metronome();
delay(200);
draw_mission();
delay(200);
draw_alram();
delay(200);
draw_rest();
delay(200);
draw_pause();
delay(200);
draw_wave();
delay(200);

}

#include <SoftwareSerial.h>
#include <Arduino.h>
#include <U8g2lib.h>
#include <SPI.h>
#include <Wire.h>
/*time function*/
unsigned long start_time = 0;
unsigned long pre_time = 0;
unsigned long cur_time = 0;

/*enum*/
enum{SETTING_MAINTAINED, SETTING_CHANGED}       //세팅 변경 = 0, 세팅 변경됨 = 1
enum{GENERAL_MODE, METRONOME_MODE, SETTING_MENU}//일반 운동모드 = 0, 메트로놈 운동모드 = 1, 세팅 메뉴 = 2
enum{WORKOUT_SETTING, TIME_SETTING}
/*time-related function*/
//int sec = 0;
//int min = 0;
//int hour =0;
//int counter =0;

/*system_status*/
enum{SYSTEM_STATUS_FLOAT = 0, SYSTEM_STATUS_ERROR, SYSTEM_STATUS_READY,
SYSTEM_STATUS_PLAYING, SYSTEM_STATUS_COUNT,SYSTEM_STATUS_END,PLAY_TIMEOUT = 29000};
int system_status = SYSTEM_STATUS_READY;

///////////////////////////////////////////////////////////////////////////////////
const int MPU = 0x68;  //MPU 6050 의 I2C 기본 주소
int speakerpin = 7;
//int inputPin = 2;   // choose input pin 7 for the push button
//char charCount ="";
//long timer = 0;
//long gyroval = 0;

/*graphic library constructor*/
U8G2_SSD1327_WS_128X128_1_4W_SW_SPI u8g2(U8G2_R0, /* clock=*/ 12, /* data=*/ 11, /* cs=*/ 10, /* dc=*/ 9, /* reset=*/ 8);

/*image coordinate*/
#define eyes_width 16
#define eyes_height 43
//left eye coordinate  x,y(27,17)
//right eye coordinate x,y(85,17)
#define smile_mouth_width 94
#define smile_mouth_height 37
//smile_mouth coordinate  x,y(17,74)
#define bad_mouth_width 94
#define bad_mouth_height 37
//bad_mouth coordinate  x,y(17,74)
#define bpm_width 93 
#define bpm_height 31
//bpm coordinate  x,y(17,48)
#define alram_width 100
#define alram_height 112
//alram coordinate  x,y(14,8)
#define dummbel_image_width 110
#define dummbel_image_height 110
//dummbel coordinate  x,y(9,9)
#define complete_width 81
#define complete_height 90
//complete coordinate  x,y(29,5)
#define setting_image_width 102
#define setting_image_height 102
//setting coordinate  x,y(13,13)
#define metronome_width 128
#define metronome_height 80
//metronome coordinate  x,y(0,25)
#define mission_width 107
#define mission_height 107
//mission coordinate  x,y(5,5)
#define rest_dot_width 30
#define rest_dot_height 30
//rest_dot1 coordinate  x,y(6,49)
//rest_dot2 coordinate  x,y(49,49)
//rest_dot3 coordinate  x,y(92,49)

/*graphic image_data_array*/
static const unsigned char eyes_bits[] U8X8_PROGMEM = {
   0xc0, 0x07, 0xf0, 0x1f, 0xf8, 0x3f, 0xfc, 0x7f, 0xfe, 0xff, 0xfe, 0xff,
   0xff, 0xff, 0xff, 0xff, 0xff, 0xff, 0xff, 0xff, 0xff, 0xff, 0xff, 0xff,
   0xff, 0xff, 0xff, 0xff, 0xff, 0xff, 0xff, 0xff, 0xff, 0xff, 0xff, 0xff,
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   0xe0, 0x0f };
static const unsigned char smile_mouth_bits[] U8X8_PROGMEM = {
   0xfe, 0x03, 0x00, 0x00, 0x00, 0x00, 0x00, 0x00, 0x00, 0x00, 0xf0, 0x1f,
   0xff, 0x07, 0x00, 0x00, 0x00, 0x00, 0x00, 0x00, 0x00, 0x00, 0xf8, 0x3f,
   0xff, 0x0f, 0x00, 0x00, 0x00, 0x00, 0x00, 0x00, 0x00, 0x00, 0xfc, 0x3f,
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   0x00, 0x00, 0x00, 0x00, 0x80, 0xff, 0x7f, 0x00, 0x00, 0x00, 0x00, 0x00 };
static const unsigned char bad_mouth_bits[] U8X8_PROGMEM = {
   0x00, 0x00, 0x00, 0x00, 0xc0, 0xff, 0xff, 0x00, 0x00, 0x00, 0x00, 0x00,
   0x00, 0x00, 0x00, 0x00, 0xfe, 0xff, 0xff, 0x1f, 0x00, 0x00, 0x00, 0x00,
   0x00, 0x00, 0x00, 0xe0, 0xff, 0xff, 0xff, 0xff, 0x01, 0x00, 0x00, 0x00,
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   0xfc, 0x01, 0x00, 0x00, 0x00, 0x00, 0x00, 0x00, 0x00, 0x00, 0xe0, 0x0f };
static const unsigned char bpm_bits[] U8X8_PROGMEM = {
   0xff, 0xff, 0x03, 0xe0, 0xff, 0x3f, 0x00, 0xfe, 0x7f, 0xc0, 0xff, 0x1f,
   0xff, 0xff, 0x1f, 0xe0, 0xff, 0xff, 0x01, 0xfe, 0x7f, 0xc0, 0xff, 0x1f,
   0xff, 0xff, 0x7f, 0xe0, 0xff, 0xff, 0x07, 0xfe, 0x7f, 0xc0, 0xff, 0x1f,
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   0xff, 0xff, 0x1f, 0xe0, 0x7f, 0x00, 0x00, 0xfe, 0xc7, 0x7f, 0xfc, 0x1f };
static const unsigned char alram_bits [] U8X8_PROGMEM = {
   0x00, 0x00, 0x00, 0x00, 0x00, 0xc0, 0x3f, 0x00, 0x00, 0x00, 0x00, 0x00,
   0x00, 0x00, 0x00, 0x00, 0x00, 0x00, 0xf8, 0xff, 0x01, 0x00, 0x00, 0x00,
   0x00, 0x00, 0x00, 0x00, 0x00, 0x00, 0x00, 0xfe, 0xff, 0x07, 0x00, 0x00,
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   0x00, 0x00, 0x00, 0x00 };
static const unsigned char dummbel_image_bits[] U8X8_PROGMEM = {
   0x00, 0x00, 0x00, 0x00, 0x00, 0x00, 0x00, 0x00, 0x00, 0xc0, 0x01, 0x00,
   0x00, 0x00, 0x00, 0x00, 0x00, 0x00, 0x00, 0x00, 0x00, 0x00, 0x00, 0xe0,
   0x07, 0x00, 0x00, 0x00, 0x00, 0x00, 0x00, 0x00, 0x00, 0x00, 0x00, 0x00,
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   0x00, 0x00, 0x00, 0x00 };
static const unsigned char complete_bits[] U8X8_PROGMEM = {
   0x00, 0x00, 0x00, 0x00, 0x00, 0x00, 0x00, 0x00, 0x00, 0x30, 0x00, 0x00,
   0x00, 0x00, 0x00, 0x00, 0x00, 0x00, 0x00, 0x00, 0x78, 0x00, 0x00, 0x00,
   0x00, 0x00, 0x00, 0x00, 0x00, 0x00, 0x00, 0xf8, 0x00, 0x00, 0x00, 0x00,
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   0xff, 0xff, 0xff, 0x03, 0x00, 0x00 };
static const unsigned char setting_image_bits[] U8X8_PROGMEM = {
   0x00, 0x00, 0x00, 0x00, 0x00, 0xf0, 0xff, 0x03, 0x00, 0x00, 0x00, 0x00,
   0x00, 0x00, 0x00, 0x00, 0x00, 0x00, 0xf0, 0xff, 0x03, 0x00, 0x00, 0x00,
   0x00, 0x00, 0x00, 0x00, 0x00, 0x00, 0x00, 0xf0, 0xff, 0x03, 0x00, 0x00,
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   0x03, 0x00, 0x00, 0x00, 0x00, 0x00 };
static const unsigned char metronome_bits[] U8X8_PROGMEM = {
   0x00, 0x00, 0x00, 0x00, 0x00, 0x00, 0x00, 0x00, 0x00, 0x80, 0x01, 0x00,
   0x00, 0x00, 0x00, 0x00, 0x00, 0x00, 0x00, 0x00, 0x00, 0x00, 0x00, 0x00,
   0x00, 0x80, 0x01, 0x00, 0x00, 0x00, 0x00, 0x00, 0x00, 0x00, 0x00, 0x00,
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   0x03, 0x00, 0x00, 0x00, 0x00, 0x00, 0x00, 0x00 };
static const unsigned char mission_bits[] U8X8_PROGMEM = {
   0x00, 0x00, 0x00, 0x00, 0x00, 0x00, 0xfe, 0x03, 0x00, 0x00, 0x00, 0x00,
   0x06, 0x00, 0x00, 0x00, 0x00, 0x00, 0x00, 0xfc, 0xff, 0xff, 0x01, 0x00,
   0x00, 0x00, 0x0f, 0x00, 0x00, 0x00, 0x00, 0x00, 0xc0, 0xff, 0xff, 0xff,
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   0x00, 0x80, 0xff, 0x0f, 0x00, 0x00, 0x00, 0x00, 0x00, 0x00 };
static const unsigned char rest_dot_bits[] U8X8_PROGMEM = {
   0x00, 0xf8, 0x0f, 0x00, 0x00, 0xff, 0x3f, 0x00, 0x80, 0xff, 0xff, 0x00,
   0xe0, 0xff, 0xff, 0x01, 0xf0, 0xff, 0xff, 0x03, 0xf8, 0xff, 0xff, 0x07,
   0xf8, 0xff, 0xff, 0x0f, 0xfc, 0xff, 0xff, 0x0f, 0xfc, 0xff, 0xff, 0x1f,
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   0x80, 0xff, 0xff, 0x00, 0x00, 0xff, 0x3f, 0x00, 0x00, 0xf8, 0x0f, 0x00 };

/*draw_fuction list*/
void draw_smile(void) {
 u8g2.firstPage();
  do {
    u8g2.drawXBMP(27,17, eyes_width, eyes_height , eyes_bits);
    u8g2.drawXBMP(85,17, eyes_width, eyes_height , eyes_bits);
    u8g2.drawXBMP(17,74, smile_mouth_width, smile_mouth_height , smile_mouth_bits);
  } while ( u8g2.nextPage() );
}
void draw_bad(void) {
 u8g2.firstPage();
  do {
    u8g2.drawXBMP(27,17, eyes_width, eyes_height , eyes_bits);
    u8g2.drawXBMP(85,17, eyes_width, eyes_height , eyes_bits);
    u8g2.drawXBMP(17,74, bad_mouth_width, bad_mouth_height , bad_mouth_bits);
  } while ( u8g2.nextPage() );
}
void draw_complete(void){
    u8g2.firstPage();
  do {
    u8g2.drawXBMP(29,5, complete_width, complete_height , complete_bits);
  } while ( u8g2.nextPage() );
}
void draw_setting(void){
     u8g2.firstPage();
  do {
    u8g2.drawXBMP(13,13, setting_image_width, setting_image_height , setting_image_bits);
  } while ( u8g2.nextPage() );
}
void draw_bpm(void){
   u8g2.firstPage();
  do {
    u8g2.drawXBMP(17,48, bpm_width, bpm_height , bpm_bits);
  } while ( u8g2.nextPage() );
}
void draw_dummbel(void){
   u8g2.firstPage();
  do {
  u8g2.drawXBMP(9,9,dummbel_image_width, dummbel_image_height, dummbel_image_bits);
   } while ( u8g2.nextPage() );
}
void draw_metronome(void){
     u8g2.firstPage();
  do {
  u8g2.drawXBMP(0,25,metronome_width, metronome_height, metronome_bits);
   } while ( u8g2.nextPage() );
}
void draw_mission(void){
  u8g2.firstPage();
  do {
  u8g2.drawXBMP(6,6,mission_width, mission_height, mission_bits);
   } while ( u8g2.nextPage() );
}
void draw_Hello(void){
  u8g2.firstPage();
  do {
    u8g2.setFont(u8g2_font_ncenB18_tr);   // choose a suitable font
    u8g2.drawStr(64,64,"Hello World!");    // write something to the internal 
   } while ( u8g2.nextPage() );
}
void draw_Value(int var){
  u8g2.firstPage();
  do {
    //Font_setting function//
    u8g2.setCursor(64,64); //coordination need to be changed
    u8g2.print(var);       // write something to the internal 
   } while ( u8g2.nextPage() );
}
void draw_alram(void){
   u8g2.firstPage();
  do {
  u8g2.drawXBMP(14,8,alram_width, alram_height, alram_bits);
   } while ( u8g2.nextPage() );
}
void draw_rest(void){
  for(int i = 0; i <= 2; i++){
   u8g2.firstPage();
  do {
  u8g2.drawXBMP(6+43*i,49,rest_dot_width, rest_dot_height, rest_dot_bits);
   } while ( u8g2.nextPage() );
   delay(500);
  } 
}
void draw_pause(void){//사각형으로 대체
  u8g2.firstPage();
  do {
//  u8g2.drawXBMP(26,23,pause_dot_width, pause_dot_height, rest_dot_bits);
//  u8g2.drawXBMP(73,23,pause_dot_width, pause_dot_height, rest_dot_bits);
    u8g2.drawBox(26,23, 30, 80);
    u8g2.drawBox(73,23, 30, 80);
   } while ( u8g2.nextPage() );
}
void draw_wave(void){
 for(int i = 0; i < 5; i++){
   u8g2.firstPage();
  do {
  u8g2.drawCircle(64,64,10+15*i,U8G2_DRAW_ALL);
   } while ( u8g2.nextPage() );
  } 
  for(int i = 0; i < 5; i++){
   u8g2.firstPage();
  do {
  u8g2.drawCircle(64,64,70-15*i,U8G2_DRAW_ALL);
   } while ( u8g2.nextPage() );
  }
}



void setup() {
  //u8g2_graphicSetting
  u8g2.begin();  
  u8g2.setFont(u8g2_font_ncenB18_tr);   // choose a suitable font

  //Wire_setting
  Wire.begin();      //Wire 라이브러리 초기화
  Wire.beginTransmission(MPU); //MPU로 데이터 전송 시작
  Wire.write(0x6B);  // PWR_MGMT_1 register
  Wire.write(0);     //MPU-6050 시작 모드로
  Wire.endTransmission(true);

  //BLE_setting,Serial_setting
  BTSerial.begin(9600);
  Serial.begin(9600);

  pre_time = millis();
  draw_dummbel(); //activate_image or LOGO image
  delay(2000);
}

void loop() {/*루프시작과함께 시간체크, 값체크하는 함수 내부에서 시간 재_체크*/
     start_time = millis();
     pre_time = millis();
     
    }


   
    
    
    delay(100); 
  // put your main code here, to run repeatedly:
}
/*메뉴함수는 함수포인터로 재지정해서 함수를 새로 넣는방식으로 변경*/
int main_menu(){ /*함수포인터로 수정*/
  while(1){
    int command = ble_check(); 
    if(command == 1){/*운동모드*/
      draw_dumbbel();
    int selection = ble_check();
    if(selection ==1)return 1; 
    }
    else if(cammand == 2){/*시간설정*/
      draw_setting();
    int selection = ble_check();
    if(selection ==1)return 0;
    }
  }
}
int sub_menu(){ /*함수포인터로 수정*/
  while(1){
    int command = ble_check(); 
    if(command == 1){/*일반운동모드*/
      draw_dumbbel();
    int selection = ble_check();
    if(selection ==1)return 1; 
    }
    else if(cammand == 2){/*메트로놈운동모드*/
      draw_metronome();
    int selection = ble_check();
    if(selection ==1)return 0;
    }
  }
}
//void BPM_setting(){
//  
//}
int ble_check(){ //ble값체크 리턴함수
  while(true){
  if(BTSerial.available()){
      Serial.write(BTSerial.read());
      byte selection = BTSerial.read();
      Serial.println(selection);
   }
   return selection;
  } 
}
int MPUdata_check(){ //MPU데이터 밸류값 체크함수
  bool checkCount = false;
  int count = 0;
  int16_t AcX,AcY,AcZ, Tmp, GyX,GyY,GyZ;
  
    while(true){ //무한 루프
    Wire.beginTransmission(MPU);    //데이터 전송시작
    Wire.write(0x3B);               // register 0x3B (ACCEL_XOUT_H), 큐에 데이터 기록
    Wire.endTransmission(false);    //연결유지
    Wire.requestFrom(MPU,6,true);  //MPU에 데이터 요청
    //데이터 한 바이트 씩 읽어서 반환
    AcX = Wire.read() << 8 | Wire.read();  // 0x3B (ACCEL_XOUT_H) & 0x3C (ACCEL_XOUT_L)    
    AcY = Wire.read() << 8 | Wire.read();  // 0x3D (ACCEL_YOUT_H) & 0x3E (ACCEL_YOUT_L)
    AcZ = Wire.read() << 8 | Wire.read();  // 0x3F (ACCEL_ZOUT_H) & 0x40 (ACCEL_ZOUT_L)
    float RADIAN_TO_DEGREES = 180/3.14139;
    float val_y = atan(AcX/sqrt(pow(AcY,2) + pow(AcZ,2))) * RADIAN_TO_DEGREES;

if(mode == 0){
   
 }
 cur_time = millis();
 if(cur_time - pre_time >= duration){
  tone(speakerpin,250,500);//메트로놈 사운드
 }
 
}
bool check_Aposition(bool* checkCount, int* count ){
   if(val_y < 0){
      if(*checkCount == false){
         *checkCount = true;
          
          *count++;
          drawValue(count);
      }
    }
     if(val_y > 80){
       if(*checkCount == true){
          *checkCount = false;
            tone(speakerpin,505,500);  //500: 음의 높낮이(주파수), 1000: 음의 지속시간(1초)
          if(count == 5){//
            count =0;
            tone(speakerpin,500,1000);  //500: 음의 높낮이(주파수), 1000: 음의 지속시간(1초)
            draw_smile();
            delay(1000);
          }
      }
    }
}
bool check_Bposition(bool* checkCount, int* count){

}
bool check_Cposition(bool* checkCount, int* count){
  
}
int complete_rate(){
  
}  
int general_mode(){

}

//int setting_mode(){//BPM설정, 알람설정 차후 결정
//
//}

void countdown(){//countDown함수
  int count = 3; //3sec
  drawValue(count);
  Serial.println("3");
  tone(speakerpin,501,500);  //500: 음의 높낮이(주파수), 1000: 음의 지속시간(1초)
  delay(1000);
  
  count--;     //2sec
  drawValue(count);
  Serial.println("2");
  tone(speakerpin,502,500);  //500: 음의 높낮이(주파수), 1000: 음의 지속시간(1초)
  delay(1000);
  
  count--;     //1sec
  drawValue(count);
  Serial.println("1");
  tone(speakerpin,503,500);  //500: 음의 높낮이(주파수), 1000: 음의 지속시간(1초)
  delay(1000);

  drawText("Start!");
  tone(speakerpin,1000,500);  //500: 음의 높낮이(주파수), 1000: 음의 지속시간(1초)
}

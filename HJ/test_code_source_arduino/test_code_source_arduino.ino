#include <SoftwareSerial.h>
#include <Arduino.h>
#include <U8g2lib.h>
#include <SPI.h>
#include <Wire.h>

/*time function*/
unsigned long start_time = 0;
unsigned long pre_time = 0;
unsigned long cur_time = 0;

/*enum*/
enum{SETTING_MAINTAINED, SETTING_CHANGED};      //0, 1
enum{WORKOUTMENU, SETTINGMENU, GENERALMENU, METRONOMEMENU, W_SETTINGMENU, TIME_SETTINGMENU};// 0, 1, 2, 3, 4, 5
enum{SYSTEM_STATUS_FLOAT = 10, SYSTEM_STATUS_ERROR = 20, SYSTEM_STATUS_READY = 30, 
SYSTEM_STATUS_PLAYING = 40, SYSTEM_STATUS_COUNT = 50 , SYSTEM_STATUS_END = 60, PLAY_TIMEOUT};


int system_status = SYSTEM_STATUS_READY;
/*time_related function*/
//int sec = 0;
//int min = 0;
//int hour =0;
//int counter =0;

/*system_status*/


///////////////////////////////////////////////////////////////////////////////////
const int MPU = 0x68;  //MPU 6050 의 I2C 기본 주소
int speakerpin = 7;
//int inputPin = 2;   // choose input pin 7 for the push button
//char charCount ="";
//long timer = 0;
//long gyroval = 0;

/*graphic library constructor*/
U8G2_SSD1327_WS_128X128_1_4W_SW_SPI u8g2(U8G2_R0, /* clock=*/ 12, /* data=*/ 11, /* cs=*/ 10, /* dc=*/ 9, /* reset=*/ 8);
SoftwareSerial BTSerial(2,3); //RX,TX
/*image coordinate*/
#define eyes_width 16
#define eyes_height 43
//left eye coordinate  x,y(27,17)
//right eye coordinate x,y(85,17)
#define smile_mouth_width 94
#define smile_mouth_height 37
//smile_mouth coordinate  x,y(17,74)
#define bad_mouth_width 94
#define bad_mouth_height 37
//bad_mouth coordinate  x,y(17,74)
#define bpm_width 93 
#define bpm_height 31
//bpm coordinate  x,y(17,48)
#define alram_width 100
#define alram_height 112
//alram coordinate  x,y(14,8)
#define dummbel_image_width 110
#define dummbel_image_height 110
//dummbel coordinate  x,y(9,9)
#define complete_width 81
#define complete_height 90
//complete coordinate  x,y(29,5)
#define setting_image_width 102
#define setting_image_height 102
//setting coordinate  x,y(13,13)
#define metronome_width 128
#define metronome_height 80
//metronome coordinate  x,y(0,25)
#define mission_width 107
#define mission_height 107
//mission coordinate  x,y(5,5)
#define rest_dot_width 30
#define rest_dot_height 30
//rest_dot1 coordinate  x,y(6,49)
//rest_dot2 coordinate  x,y(49,49)
//rest_dot3 coordinate  x,y(92,49)

/*graphic image_data_array*/
static const unsigned char eyes_bits[] U8X8_PROGMEM = {
   0xc0, 0x07, 0xf0, 0x1f, 0xf8, 0x3f, 0xfc, 0x7f, 0xfe, 0xff, 0xfe, 0xff,
   0xff, 0xff, 0xff, 0xff, 0xff, 0xff, 0xff, 0xff, 0xff, 0xff, 0xff, 0xff,
   0xff, 0xff, 0xff, 0xff, 0xff, 0xff, 0xff, 0xff, 0xff, 0xff, 0xff, 0xff,
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   0xe0, 0x0f };
static const unsigned char smile_mouth_bits[] U8X8_PROGMEM = {
   0xfe, 0x03, 0x00, 0x00, 0x00, 0x00, 0x00, 0x00, 0x00, 0x00, 0xf0, 0x1f,
   0xff, 0x07, 0x00, 0x00, 0x00, 0x00, 0x00, 0x00, 0x00, 0x00, 0xf8, 0x3f,
   0xff, 0x0f, 0x00, 0x00, 0x00, 0x00, 0x00, 0x00, 0x00, 0x00, 0xfc, 0x3f,
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   0x00, 0x00, 0x00, 0x00, 0x80, 0xff, 0x7f, 0x00, 0x00, 0x00, 0x00, 0x00 };
static const unsigned char bad_mouth_bits[] U8X8_PROGMEM = {
   0x00, 0x00, 0x00, 0x00, 0xc0, 0xff, 0xff, 0x00, 0x00, 0x00, 0x00, 0x00,
   0x00, 0x00, 0x00, 0x00, 0xfe, 0xff, 0xff, 0x1f, 0x00, 0x00, 0x00, 0x00,
   0x00, 0x00, 0x00, 0xe0, 0xff, 0xff, 0xff, 0xff, 0x01, 0x00, 0x00, 0x00,
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   0xfc, 0x01, 0x00, 0x00, 0x00, 0x00, 0x00, 0x00, 0x00, 0x00, 0xe0, 0x0f };
static const unsigned char bpm_bits[] U8X8_PROGMEM = {
   0xff, 0xff, 0x03, 0xe0, 0xff, 0x3f, 0x00, 0xfe, 0x7f, 0xc0, 0xff, 0x1f,
   0xff, 0xff, 0x1f, 0xe0, 0xff, 0xff, 0x01, 0xfe, 0x7f, 0xc0, 0xff, 0x1f,
   0xff, 0xff, 0x7f, 0xe0, 0xff, 0xff, 0x07, 0xfe, 0x7f, 0xc0, 0xff, 0x1f,
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   0xff, 0xff, 0x1f, 0xe0, 0x7f, 0x00, 0x00, 0xfe, 0xc7, 0x7f, 0xfc, 0x1f };
static const unsigned char alram_bits [] U8X8_PROGMEM = {
   0x00, 0x00, 0x00, 0x00, 0x00, 0xc0, 0x3f, 0x00, 0x00, 0x00, 0x00, 0x00,
   0x00, 0x00, 0x00, 0x00, 0x00, 0x00, 0xf8, 0xff, 0x01, 0x00, 0x00, 0x00,
   0x00, 0x00, 0x00, 0x00, 0x00, 0x00, 0x00, 0xfe, 0xff, 0x07, 0x00, 0x00,
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   0x00, 0x00, 0x00, 0x00 };
static const unsigned char dummbel_image_bits[] U8X8_PROGMEM = {
   0x00, 0x00, 0x00, 0x00, 0x00, 0x00, 0x00, 0x00, 0x00, 0xc0, 0x01, 0x00,
   0x00, 0x00, 0x00, 0x00, 0x00, 0x00, 0x00, 0x00, 0x00, 0x00, 0x00, 0xe0,
   0x07, 0x00, 0x00, 0x00, 0x00, 0x00, 0x00, 0x00, 0x00, 0x00, 0x00, 0x00,
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   0x00, 0x00, 0x00, 0x00 };
static const unsigned char complete_bits[] U8X8_PROGMEM = {
   0x00, 0x00, 0x00, 0x00, 0x00, 0x00, 0x00, 0x00, 0x00, 0x30, 0x00, 0x00,
   0x00, 0x00, 0x00, 0x00, 0x00, 0x00, 0x00, 0x00, 0x78, 0x00, 0x00, 0x00,
   0x00, 0x00, 0x00, 0x00, 0x00, 0x00, 0x00, 0xf8, 0x00, 0x00, 0x00, 0x00,
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   0xff, 0xff, 0xff, 0x03, 0x00, 0x00 };
static const unsigned char setting_image_bits[] U8X8_PROGMEM = {
   0x00, 0x00, 0x00, 0x00, 0x00, 0xf0, 0xff, 0x03, 0x00, 0x00, 0x00, 0x00,
   0x00, 0x00, 0x00, 0x00, 0x00, 0x00, 0xf0, 0xff, 0x03, 0x00, 0x00, 0x00,
   0x00, 0x00, 0x00, 0x00, 0x00, 0x00, 0x00, 0xf0, 0xff, 0x03, 0x00, 0x00,
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   0x03, 0x00, 0x00, 0x00, 0x00, 0x00 };
static const unsigned char metronome_bits[] U8X8_PROGMEM = {
   0x00, 0x00, 0x00, 0x00, 0x00, 0x00, 0x00, 0x00, 0x00, 0x80, 0x01, 0x00,
   0x00, 0x00, 0x00, 0x00, 0x00, 0x00, 0x00, 0x00, 0x00, 0x00, 0x00, 0x00,
   0x00, 0x80, 0x01, 0x00, 0x00, 0x00, 0x00, 0x00, 0x00, 0x00, 0x00, 0x00,
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   0x03, 0x00, 0x00, 0x00, 0x00, 0x00, 0x00, 0x00 };
static const unsigned char mission_bits[] U8X8_PROGMEM = {
   0x00, 0x00, 0x00, 0x00, 0x00, 0x00, 0xfe, 0x03, 0x00, 0x00, 0x00, 0x00,
   0x06, 0x00, 0x00, 0x00, 0x00, 0x00, 0x00, 0xfc, 0xff, 0xff, 0x01, 0x00,
   0x00, 0x00, 0x0f, 0x00, 0x00, 0x00, 0x00, 0x00, 0xc0, 0xff, 0xff, 0xff,
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   0x00, 0x80, 0xff, 0x0f, 0x00, 0x00, 0x00, 0x00, 0x00, 0x00 };
static const unsigned char rest_dot_bits[] U8X8_PROGMEM = {
   0x00, 0xf8, 0x0f, 0x00, 0x00, 0xff, 0x3f, 0x00, 0x80, 0xff, 0xff, 0x00,
   0xe0, 0xff, 0xff, 0x01, 0xf0, 0xff, 0xff, 0x03, 0xf8, 0xff, 0xff, 0x07,
   0xf8, 0xff, 0xff, 0x0f, 0xfc, 0xff, 0xff, 0x0f, 0xfc, 0xff, 0xff, 0x1f,
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   0x80, 0xff, 0xff, 0x00, 0x00, 0xff, 0x3f, 0x00, 0x00, 0xf8, 0x0f, 0x00 };

/*draw_fuction list*/
void draw_smile(void) {
 u8g2.firstPage();
  do {
    u8g2.drawXBMP(27,17, eyes_width, eyes_height , eyes_bits);
    u8g2.drawXBMP(85,17, eyes_width, eyes_height , eyes_bits);
    u8g2.drawXBMP(17,74, smile_mouth_width, smile_mouth_height , smile_mouth_bits);
    u8g2.setFont(u8g2_font_ncenB14_tr);   // choose a suitable font           //font setting
    u8g2.drawStr(5,64, "Health Mile!");    // write something to the internal //image + text
  } while ( u8g2.nextPage() );
}
void draw_bad(void) {
 u8g2.firstPage();
  do {
    u8g2.drawXBMP(27,17, eyes_width, eyes_height , eyes_bits);
    u8g2.drawXBMP(85,17, eyes_width, eyes_height , eyes_bits);
    u8g2.drawXBMP(17,74, bad_mouth_width, bad_mouth_height , bad_mouth_bits);
  } while ( u8g2.nextPage() );
}
void draw_complete(void){
    u8g2.firstPage();
  do {
    u8g2.drawXBMP(29,5, complete_width, complete_height , complete_bits);
  } while ( u8g2.nextPage() );
}
void draw_setting(void){
     u8g2.firstPage();
  do {
    u8g2.drawXBMP(13,13, setting_image_width, setting_image_height , setting_image_bits);
  } while ( u8g2.nextPage() );
}
void draw_bpm(void){
   u8g2.firstPage();
  do {
    u8g2.drawXBMP(17,48, bpm_width, bpm_height , bpm_bits);
  } while ( u8g2.nextPage() );
}
void draw_dummbel(void){
   u8g2.firstPage();
  do {
  u8g2.drawXBMP(9,9,dummbel_image_width, dummbel_image_height, dummbel_image_bits);
   } while ( u8g2.nextPage() );
}
void draw_metronome(void){
     u8g2.firstPage();
  do {
  u8g2.drawXBMP(0,25,metronome_width, metronome_height, metronome_bits);
   } while ( u8g2.nextPage() );
}
void draw_mission(void){
  u8g2.firstPage();
  do {
  u8g2.drawXBMP(6,6,mission_width, mission_height, mission_bits);
   } while ( u8g2.nextPage() );
}
void draw_text(const char* text,int x,int y){
  u8g2.firstPage();
  do {
    u8g2.setFont(u8g2_font_ncenB18_tr);   // choose a suitable font
    u8g2.drawStr(x,y, text);    // write something to the internal 
   } while ( u8g2.nextPage() );
}
void draw_Value(int var){
  u8g2.firstPage();
  do {
    //Font_setting function//
    u8g2.setCursor(64,64); //coordination need to be changed
    u8g2.print(var);       // write something to the internal 
   } while ( u8g2.nextPage() );
}
void draw_alram(void){
   u8g2.firstPage();
  do {
  u8g2.drawXBMP(14,8,alram_width, alram_height, alram_bits);
   } while ( u8g2.nextPage() );
}
void draw_rest(void){
  for(int i = 0; i <= 2; i++){
   u8g2.firstPage();
  do {
  u8g2.drawXBMP(6+43*i,49,rest_dot_width, rest_dot_height, rest_dot_bits);
   } while ( u8g2.nextPage() );
   delay(500);
  } 
}
void draw_pause(void){
  u8g2.firstPage();
  do {
    u8g2.drawBox(26,23, 30, 80);
    u8g2.drawBox(73,23, 30, 80);
   } while ( u8g2.nextPage() );
}
void draw_wave(void){
 for(int i = 0; i < 5; i++){
   u8g2.firstPage();
  do {
  u8g2.drawCircle(64,64,10+15*i,U8G2_DRAW_ALL);
   } while ( u8g2.nextPage() );
  } 
  for(int i = 0; i < 5; i++){
   u8g2.firstPage();
  do {
  u8g2.drawCircle(64,64,70-15*i,U8G2_DRAW_ALL);
   } while ( u8g2.nextPage() );
  }
}
/*setup function*/
void setup() {
  u8g2.begin();                         // u8g2 library setting
  u8g2.setFont(u8g2_font_ncenB18_tr);   // choose a suitable font

  //Wire_setting
  Wire.begin();                // Wire library setting
  Wire.beginTransmission(MPU); // MPU data transmission begin
  Wire.write(0x6B);            // PWR_MGMT_1 register
  Wire.write(0);               // MPU-6050 begin mode change
  Wire.endTransmission(true);  // MPU-6050 transmission end

  //BLE_setting,Serial_setting
  BTSerial.begin(9600);        //BLE library setting
  Serial.begin(9600);          //Serial library setting

  pre_time = millis(); //RTC //time_start
  draw_smile();      //activate_image or LOGO image

//  u8g2.setFont(u8g2_font_ncenB14_tr);
//  u8g2.drawStr(10,128,"Hello World!");
//  delay(2000);
 
  delay(2000);
}

void loop() {
  
  // put your main code here, to run repeatedly:

}

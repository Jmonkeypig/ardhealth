#include <SoftwareSerial.h>

SoftwareSerial BTSerial(2,3); //RX,TX

#include <Arduino.h>
#include <U8g2lib.h>

#ifdef U8X8_HAVE_HW_SPI
#include <SPI.h>
#endif
#ifdef U8X8_HAVE_HW_I2C
#include <Wire.h>
#endif

#define SYSTEM_STATUS_FLOAT 10
#define SYSTEM_STATUS_ERROR 20
#define SYSTEM_STATUS_READY 30
#define SYSTEM_STATUS_PLAYING 40
#define SYSTEM_STATUS_COUNT 50
#define SYSTEM_STATUS_END 60

#define PLAY_TIMEOUT 29000


const int MPU = 0x68;  //MPU 6050 의 I2C 기본 주소
int16_t AcX,AcY,AcZ, Tmp, GyX,GyY,GyZ;
//long int end_check_time = -1;
int system_status = SYSTEM_STATUS_READY;
int speakerpin = 7;
//int inputPin = 2;   // choose input pin 7 for the push button
long count = 0;
//char charCount ="";
//long timer = 0;
//long gyroval = 0;
bool checkCount = true;
char inString = 'a';
U8G2_SSD1327_WS_128X128_1_4W_SW_SPI u8g2(U8G2_R0, /* clock=*/ 12, /* data=*/ 11, /* cs=*/ 10, /* dc=*/ 9, /* reset=*/ 8);
//display constructor

#define eyes_width 16
#define eyes_height 43
//left eye coordinate  x,y(27,17)
//right eye coordinate x,y(85,17)
static const unsigned char eyes_bits[] U8X8_PROGMEM = {
   0xc0, 0x07, 0xf0, 0x1f, 0xf8, 0x3f, 0xfc, 0x7f, 0xfe, 0xff, 0xfe, 0xff,
   0xff, 0xff, 0xff, 0xff, 0xff, 0xff, 0xff, 0xff, 0xff, 0xff, 0xff, 0xff,
   0xff, 0xff, 0xff, 0xff, 0xff, 0xff, 0xff, 0xff, 0xff, 0xff, 0xff, 0xff,
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   0xe0, 0x0f };

#define smile_mouth_width 94
#define smile_mouth_height 37
//smile_mouth coordinate  x,y(17,74)

static const unsigned char smile_mouth_bits[] U8X8_PROGMEM = {
   0xfe, 0x03, 0x00, 0x00, 0x00, 0x00, 0x00, 0x00, 0x00, 0x00, 0xf0, 0x1f,
   0xff, 0x07, 0x00, 0x00, 0x00, 0x00, 0x00, 0x00, 0x00, 0x00, 0xf8, 0x3f,
   0xff, 0x0f, 0x00, 0x00, 0x00, 0x00, 0x00, 0x00, 0x00, 0x00, 0xfc, 0x3f,
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   0x00, 0x00, 0x00, 0x00, 0x80, 0xff, 0x7f, 0x00, 0x00, 0x00, 0x00, 0x00 };

#define bad_mouth_width 94
#define bad_mouth_height 37
//bad_mouth coordinate  x,y(17,74)
static const unsigned char bad_mouth_bits[] U8X8_PROGMEM = {
   0x00, 0x00, 0x00, 0x00, 0xc0, 0xff, 0xff, 0x00, 0x00, 0x00, 0x00, 0x00,
   0x00, 0x00, 0x00, 0x00, 0xfe, 0xff, 0xff, 0x1f, 0x00, 0x00, 0x00, 0x00,
   0x00, 0x00, 0x00, 0xe0, 0xff, 0xff, 0xff, 0xff, 0x01, 0x00, 0x00, 0x00,
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   0xfc, 0x01, 0x00, 0x00, 0x00, 0x00, 0x00, 0x00, 0x00, 0x00, 0xe0, 0x0f };




#define bpm_width 93 
#define bpm_height 31
//bpm coordinate  x,y(17,48)
static const unsigned char bpm_bits[] U8X8_PROGMEM = {
   0xff, 0xff, 0x03, 0xe0, 0xff, 0x3f, 0x00, 0xfe, 0x7f, 0xc0, 0xff, 0x1f,
   0xff, 0xff, 0x1f, 0xe0, 0xff, 0xff, 0x01, 0xfe, 0x7f, 0xc0, 0xff, 0x1f,
   0xff, 0xff, 0x7f, 0xe0, 0xff, 0xff, 0x07, 0xfe, 0x7f, 0xc0, 0xff, 0x1f,
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   0xff, 0xff, 0x1f, 0xe0, 0x7f, 0x00, 0x00, 0xfe, 0xc7, 0x7f, 0xfc, 0x1f };

#define alram_width 100
#define alram_height 112
//alram coordinate  x,y(14,8)
static const unsigned char alram_bits [] U8X8_PROGMEM = {
   0x00, 0x00, 0x00, 0x00, 0x00, 0xc0, 0x3f, 0x00, 0x00, 0x00, 0x00, 0x00,
   0x00, 0x00, 0x00, 0x00, 0x00, 0x00, 0xf8, 0xff, 0x01, 0x00, 0x00, 0x00,
   0x00, 0x00, 0x00, 0x00, 0x00, 0x00, 0x00, 0xfe, 0xff, 0x07, 0x00, 0x00,
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   0x00, 0x00, 0x00, 0x00 };

#define dummbel_image_width 110
#define dummbel_image_height 110
//dummbel coordinate  x,y(9,9)
static const unsigned char dummbel_image_bits[] U8X8_PROGMEM = {
   0x00, 0x00, 0x00, 0x00, 0x00, 0x00, 0x00, 0x00, 0x00, 0xc0, 0x01, 0x00,
   0x00, 0x00, 0x00, 0x00, 0x00, 0x00, 0x00, 0x00, 0x00, 0x00, 0x00, 0xe0,
   0x07, 0x00, 0x00, 0x00, 0x00, 0x00, 0x00, 0x00, 0x00, 0x00, 0x00, 0x00,
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   0x00, 0x00, 0x00, 0x00 };

   #define complete_width 81
   #define complete_height 90
   //complete coordinate  x,y(29,5)
static const unsigned char complete_bits[] U8X8_PROGMEM = {
   0x00, 0x00, 0x00, 0x00, 0x00, 0x00, 0x00, 0x00, 0x00, 0x30, 0x00, 0x00,
   0x00, 0x00, 0x00, 0x00, 0x00, 0x00, 0x00, 0x00, 0x78, 0x00, 0x00, 0x00,
   0x00, 0x00, 0x00, 0x00, 0x00, 0x00, 0x00, 0xf8, 0x00, 0x00, 0x00, 0x00,
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   0xff, 0xff, 0xff, 0x03, 0x00, 0x00 };

#define setting_image_width 102
#define setting_image_height 102
//setting coordinate  x,y(13,13)
static const unsigned char setting_image_bits[] U8X8_PROGMEM = {
   0x00, 0x00, 0x00, 0x00, 0x00, 0xf0, 0xff, 0x03, 0x00, 0x00, 0x00, 0x00,
   0x00, 0x00, 0x00, 0x00, 0x00, 0x00, 0xf0, 0xff, 0x03, 0x00, 0x00, 0x00,
   0x00, 0x00, 0x00, 0x00, 0x00, 0x00, 0x00, 0xf0, 0xff, 0x03, 0x00, 0x00,
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   0x03, 0x00, 0x00, 0x00, 0x00, 0x00 };

#define metronome_width 128
#define metronome_height 80
//metronome coordinate  x,y(0,25)
static const unsigned char metronome_bits[] U8X8_PROGMEM = {
   0x00, 0x00, 0x00, 0x00, 0x00, 0x00, 0x00, 0x00, 0x00, 0x80, 0x01, 0x00,
   0x00, 0x00, 0x00, 0x00, 0x00, 0x00, 0x00, 0x00, 0x00, 0x00, 0x00, 0x00,
   0x00, 0x80, 0x01, 0x00, 0x00, 0x00, 0x00, 0x00, 0x00, 0x00, 0x00, 0x00,
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   0x03, 0x00, 0x00, 0x00, 0x00, 0x00, 0x00, 0x00 };

#define mission_width 107
#define mission_height 107
//mission coordinate  x,y(5,5)
static const unsigned char mission_bits[] U8X8_PROGMEM = {
   0x00, 0x00, 0x00, 0x00, 0x00, 0x00, 0xfe, 0x03, 0x00, 0x00, 0x00, 0x00,
   0x06, 0x00, 0x00, 0x00, 0x00, 0x00, 0x00, 0xfc, 0xff, 0xff, 0x01, 0x00,
   0x00, 0x00, 0x0f, 0x00, 0x00, 0x00, 0x00, 0x00, 0xc0, 0xff, 0xff, 0xff,
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   0x00, 0x80, 0xff, 0x0f, 0x00, 0x00, 0x00, 0x00, 0x00, 0x00 };

#define rest_dot_width 30
#define rest_dot_height 30
//rest_dot1 coordinate  x,y(6,49)
//rest_dot2 coordinate  x,y(49,49)
//rest_dot3 coordinate  x,y(92,49)
static const unsigned char rest_dot_bits[] U8X8_PROGMEM = {
   0x00, 0xf8, 0x0f, 0x00, 0x00, 0xff, 0x3f, 0x00, 0x80, 0xff, 0xff, 0x00,
   0xe0, 0xff, 0xff, 0x01, 0xf0, 0xff, 0xff, 0x03, 0xf8, 0xff, 0xff, 0x07,
   0xf8, 0xff, 0xff, 0x0f, 0xfc, 0xff, 0xff, 0x0f, 0xfc, 0xff, 0xff, 0x1f,
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   0x80, 0xff, 0xff, 0x00, 0x00, 0xff, 0x3f, 0x00, 0x00, 0xf8, 0x0f, 0x00 };

//draw_fuction list
void draw_smile(void) {
 u8g2.firstPage();
  do {
    u8g2.drawXBMP(27,17, eyes_width, eyes_height , eyes_bits);
    u8g2.drawXBMP(85,17, eyes_width, eyes_height , eyes_bits);
    u8g2.drawXBMP(17,74, smile_mouth_width, smile_mouth_height , smile_mouth_bits);
  } while ( u8g2.nextPage() );
}
void draw_bad(void) {
 u8g2.firstPage();
  do {
    u8g2.drawXBMP(27,17, eyes_width, eyes_height , eyes_bits);
    u8g2.drawXBMP(85,17, eyes_width, eyes_height , eyes_bits);
    u8g2.drawXBMP(17,74, bad_mouth_width, bad_mouth_height , bad_mouth_bits);
  } while ( u8g2.nextPage() );
}
void draw_complete(void){
    u8g2.firstPage();
  do {
    u8g2.drawXBMP(29,5, complete_width, complete_height , complete_bits);
  } while ( u8g2.nextPage() );
}
void draw_setting(void){
     u8g2.firstPage();
  do {
    u8g2.drawXBMP(13,13, setting_image_width, setting_image_height , setting_image_bits);
  } while ( u8g2.nextPage() );
}
void draw_bpm(void){
   u8g2.firstPage();
  do {
    u8g2.drawXBMP(17,48, bpm_width, bpm_height , bpm_bits);
  } while ( u8g2.nextPage() );
}
void draw_dummbel(void){
   u8g2.firstPage();
  do {
  u8g2.drawXBMP(9,9,dummbel_image_width, dummbel_image_height, dummbel_image_bits);
   } while ( u8g2.nextPage() );
}
void draw_metronome(void){
     u8g2.firstPage();
  do {
  u8g2.drawXBMP(0,25,metronome_width, metronome_height, metronome_bits);
   } while ( u8g2.nextPage() );
}
void draw_mission(void){
  u8g2.firstPage();
  do {
  u8g2.drawXBMP(6,6,mission_width, mission_height, mission_bits);
   } while ( u8g2.nextPage() );
}

void drawHello(void){
  u8g2.firstPage();
  do {
    u8g2.setFont(u8g2_font_ncenB18_tr);   // choose a suitable font
    u8g2.drawStr(64,64,"Hello World!");    // write something to the internal 
   } while ( u8g2.nextPage() );
}

void drawFloat(int var){
  u8g2.firstPage();
  do {
    
    u8g2.setCursor(64,64);
    u8g2.print(var);    // write something to the internal 
   } while ( u8g2.nextPage() );
}

void draw_alram(void){
   u8g2.firstPage();
  do {
  u8g2.drawXBMP(14,8,alram_width, alram_height, alram_bits);
   } while ( u8g2.nextPage() );
}

void draw_rest(void){
  for(int i = 0; i <= 2; i++){
   u8g2.firstPage();
  do {
  u8g2.drawXBMP(6+43*i,49,rest_dot_width, rest_dot_height, rest_dot_bits);
   } while ( u8g2.nextPage() );
   delay(500);
  } 
}
void draw_pause(void) //사각형으로 대체
{
  u8g2.firstPage();
  do {
//  u8g2.drawXBMP(26,23,pause_dot_width, pause_dot_height, rest_dot_bits);
//  u8g2.drawXBMP(73,23,pause_dot_width, pause_dot_height, rest_dot_bits);
    u8g2.drawBox(26,23, 30, 80);
    u8g2.drawBox(73,23, 30, 80);
   } while ( u8g2.nextPage() );
}
void draw_wave(void)
{
 for(int i = 0; i < 5; i++){
   u8g2.firstPage();
  do {
  u8g2.drawCircle(64,64,10+15*i,U8G2_DRAW_ALL);
   } while ( u8g2.nextPage() );
  } 
  for(int i = 0; i < 5; i++){
   u8g2.firstPage();
  do {
  u8g2.drawCircle(64,64,70-15*i,U8G2_DRAW_ALL);
   } while ( u8g2.nextPage() );
  }
}


void setup(void) {
  
  u8g2.begin();  
  u8g2.setFont(u8g2_font_ncenB18_tr);   // choose a suitable font
  Wire.begin();      //Wire 라이브러리 초기화
  Wire.beginTransmission(MPU); //MPU로 데이터 전송 시작
  Wire.write(0x6B);  // PWR_MGMT_1 register
  Wire.write(0);     //MPU-6050 시작 모드로
  Wire.endTransmission(true);
  
  BTSerial.begin(9600);
  Serial.begin(9600);

  
}
void writeString(String stringData) { // Used to serially push out a String with Serial.write()

  for (int i = 0; i < stringData.length(); i++)
  {
    BTSerial.write(stringData[i]);   // Push each char 1 by 1 on each loop pass
  }

}// end writeString

void loop(void) {
  if (system_status == SYSTEM_STATUS_READY) {
    
    draw_smile();

    if(BTSerial.available()){
      int inChar = BTSerial.read();
       
      if (isDigit(inChar)) {
        // convert the incoming byte to a char and add it to the string:
        inString = (char)inChar;
        Serial.println(inString);
        if(inString == '0'){
          Serial.println("count");
          tone(speakerpin,500,500);  //500: 음의 높낮이(주파수), 1000: 음의 지속시간(1초)
          system_status = SYSTEM_STATUS_COUNT;
        }
      }
      
    }
    delay(100);
  }
  if (system_status == SYSTEM_STATUS_COUNT) {
    Serial.println("3");
    count = 3;
//    u8g2.clearBuffer();                    // clear the internal memory
//u8g2.firstPage();
    draw_dummbel();
    tone(speakerpin,501,500);  //500: 음의 높낮이(주파수), 1000: 음의 지속시간(1초)
    delay(1000);
    Serial.println("2");
    count = 2;
    tone(speakerpin,502,500);  //500: 음의 높낮이(주파수), 1000: 음의 지속시간(1초)
    delay(1000);
    count = 1;
    Serial.println("1");
    tone(speakerpin,503,500);  //500: 음의 높낮이(주파수), 1000: 음의 지속시간(1초)
    delay(1000);
    count = 0;
    system_status = SYSTEM_STATUS_PLAYING;
  } else if (system_status == SYSTEM_STATUS_PLAYING) {
    Wire.beginTransmission(MPU);    //데이터 전송시작
    Wire.write(0x3B);               // register 0x3B (ACCEL_XOUT_H), 큐에 데이터 기록
    Wire.endTransmission(false);    //연결유지
      
    Wire.requestFrom(MPU,6,true);  //MPU에 데이터 요청
    
  
    //데이터 한 바이트 씩 읽어서 반환
    AcX = Wire.read() << 8 | Wire.read();  // 0x3B (ACCEL_XOUT_H) & 0x3C (ACCEL_XOUT_L)    
    AcY = Wire.read() << 8 | Wire.read();  // 0x3D (ACCEL_YOUT_H) & 0x3E (ACCEL_YOUT_L)
    AcZ = Wire.read() << 8 | Wire.read();  // 0x3F (ACCEL_ZOUT_H) & 0x40 (ACCEL_ZOUT_L)
    //Tmp = Wire.read() << 8 | Wire.read();  // 0x41 (TEMP_OUT_H) & 0x42 (TEMP_OUT_L)
    //GyX = Wire.read() << 8 | Wire.read();  // 0x43 (GYRO_XOUT_H) & 0x44 (GYRO_XOUT_L)
    //GyY = Wire.read() << 8 | Wire.read();  // 0x45 (GYRO_YOUT_H) & 0x46 (GYRO_YOUT_L)
    //GyZ = Wire.read() << 8 | Wire.read();  // 0x47 (GYRO_ZOUT_H) & 0x48 (GYRO_ZOUT_L)
  
  
    float RADIAN_TO_DEGREES = 180/3.14139;
    float val_y = atan(AcX/sqrt(pow(AcY,2) + pow(AcZ,2))) * RADIAN_TO_DEGREES;
//    float val_x = atan(AcY/sqrt(pow(AcX,2) + pow(AcZ,2))) * RADIAN_TO_DEGREES;
  
    //시리얼 모니터에 출력
    //Serial.print("AcX = "); 
//    Serial.println(val_y);
  //Serial.print(" | AcY = "); Serial.println(val_x);
//  Serial.print(" | AcZ = "); Serial.println(AcZ);
  //Serial.print(" | Tmp = "); Serial.print(Tmp/340.00+36.53);  
//  Serial.print(" | GyX = "); Serial.println(GyX);
  //Serial.print(" | GyY = "); Serial.print(GyY);
//  Serial.print(" | GyZ = "); Serial.println(GyZ);
  
    if(val_y < 0){
      if(checkCount == true){
          checkCount = false;
          
          count = count +1;
          drawFloat(count);
//          char ShowData = count;
//          BTSerial.write(ShowData);
          writeString(String(count));
      }
    }

     if(val_y > 80){
      if(checkCount == false){
          checkCount = true;
          tone(speakerpin,505,500);  //500: 음의 높낮이(주파수), 1000: 음의 지속시간(1초)
          if(count ==10){
            count =0;
            
            tone(speakerpin,500,500);  //500: 음의 높낮이(주파수), 1000: 음의 지속시간(1초)
            draw_smile();
            
          delay(200);
          }
      }
    }

     if(BTSerial.available()){

//      Serial.write(BTSerial.read());
        int inChar = BTSerial.read();
       
      if (isDigit(inChar)) {
        // convert the incoming byte to a char and add it to the string:
        inString = (char)inChar;
        if(inString == '1'){
          Serial.println("testetetet");
          tone(speakerpin,500,500);  //500: 음의 높낮이(주파수), 1000: 음의 지속시간(1초)
          system_status = SYSTEM_STATUS_READY;
        }
      }
    }


   if(Serial.available()){
    BTSerial.write(Serial.read());
    }
    
    
    delay(100); 
  }
  
//draw_bpm();
//delay(200);
//draw_setting();
//delay(200);
//draw_bad();
//delay(200);
//draw_smile();
//delay(200);
//draw_dummbel();
//delay(200);
//draw_metronome();
//delay(200);
//draw_mission();
//delay(200);
//draw_alram();
//delay(200);
//draw_rest();
//delay(200);
//draw_pause();
//delay(200);
//draw_wave();
//delay(200);
}
